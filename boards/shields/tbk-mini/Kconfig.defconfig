## boards/shields/tbk-mini/Kconfig.defconfig
```kconfig
if SHIELD_TBK_LEFT

config ZMK_KEYBOARD_NAME
	default "TBK-Mini"

config ZMK_SPLIT_BLE_ROLE_CENTRAL
	default y

endif

if SHIELD_TBK_RIGHT

config ZMK_KEYBOARD_NAME
	default "TBK-Mini Right"

endif

if SHIELD_TBK_LEFT || SHIELD_TBK_RIGHT

config ZMK_SPLIT
	default y
	
endif
```

## boards/shields/tbk-mini/Kconfig.shield
```kconfig
config SHIELD_TBK_LEFT
	def_bool $(shields_list_contains,tbk-mini_left)

config SHIELD_TBK_RIGHT
	def_bool $(shields_list_contains,tbk-mini_right)
```
